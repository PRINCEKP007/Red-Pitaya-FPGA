/dts-v1/;
/plugin/;

&{/} {
    led-system {
        compatible = "gpio-leds";

        led-8-yellow {
            label = "led8";
            gpios = <&gpio0 0 0>;
            linux,default-trigger = "mmc0";
            default-state = "off";
        };
    };
};
